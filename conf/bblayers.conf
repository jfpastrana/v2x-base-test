## conf/bblayers.conf
```bitbake
# POKY_BBLAYERS_CONF_VERSION is increased each time build/conf/bblayers.conf
# changes incompatibly
POKY_BBLAYERS_CONF_VERSION = "2"

BBPATH = "${TOPDIR}"
BBFILES ?= ""

BBLAYERS ?= " \
  /media/avenger/homeusers/Yocto/hummingboard2/poky/meta \
  /media/avenger/homeusers/Yocto/hummingboard2/poky/meta-poky \
  /media/avenger/homeusers/Yocto/hummingboard2/poky/meta-solidrun-bsp \
  /media/avenger/homeusers/Yocto/hummingboard2/poky/meta-freescale \
  /media/avenger/homeusers/Yocto/hummingboard2/poky/meta-openembedded/meta-oe \
  /media/avenger/homeusers/Yocto/hummingboard2/poky/meta-openembedded/meta-python \
  /media/avenger/homeusers/Yocto/hummingboard2/poky/meta-openembedded/meta-networking \
  /media/avenger/homeusers/Yocto/hummingboard2/poky/meta-v2x \
  "
```
